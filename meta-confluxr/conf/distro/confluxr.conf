## meta-confluxr/conf/distro/confluxr.conf
```bitbake
DISTRO_NAME = "ConfluxR (ConfluxR Embedded Linux Distro)"

DISTRO_VERSION = "0.1"

DISTRO_FEATURES:append = " systemd"
DISTRO_FEATURES:append = " virtualization"
DISTRO_FEATURES:append = " seccomp"
DISTRO_FEATURES:append = " k3s"
```
